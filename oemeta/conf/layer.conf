## oemeta/conf/layer.conf
```bitbake
# We have a conf and classes directory, add to BBPATH
BBPATH .= ":${LAYERDIR}"

# We have a packages directory, add to BBFILES
BBFILES += "${LAYERDIR}/recipes-*/*/*.bb \
            ${LAYERDIR}/recipes-*/*/*.bbappend"

BBFILE_COLLECTIONS += "kindle"
BBFILE_PATTERN_kindle = "^${LAYERDIR}/"
BBFILE_PRIORITY_kindle = "5"

LAYER_LICENSE_DIR = "${LAYERDIR}/files/additional-licenses"
LICENSE_PATH += "${LAYER_LICENSE_DIR}"
```

## oemeta/conf/machine/include/imx50-common.inc
```bitbake
# Provides the i.MX50 common settings

require conf/machine/include/imx-base.inc

# Tune for soft float-point with neon co-processor
DEFAULTTUNE_mx50 ?= "cortexa8t-neon"
require conf/machine/include/tune-cortexa8.inc

UBOOT_ENTRYPOINT_mx50 = "0x70008000"
```

## oemeta/conf/machine/kindle-touch.conf
```bitbake
#@TYPE: Machine
#@NAME: Kindle Touch
#@SOC: i.MX508
#@DESCRIPTION: Machine configuration for Kindle Touch e-reader

require conf/machine/include/imx50-common.inc

SOC_FAMILY = "mx5:mx50:mx508"

MACHINE_FEATURES += "wifi"
```

## oemeta/conf/machine/kindle-voyage.conf
```bitbake
#@TYPE: Machine
#@NAME: Kindle Voyage
#@SOC: i.MX6SL
#@DESCRIPTION: Machine configuration for Kindle Voyage e-reader

include conf/machine/include/imx-base.inc
include conf/machine/include/tune-cortexa9.inc

SOC_FAMILY = "mx6:mx6sl"
```
